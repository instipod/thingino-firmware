## configs/cameras/cinnado_d1_t23n_sc2331_usbmod/cinnado_d1_t23n_sc2331_usbmod_defconfig
```kconfig
# NAME: Cinnado D1 (T23N, SC2331, USB-ETH mod)
# FRAG: soc-xburst1 core
BR2_INGENIC_SOC_MODEL="t23n"
BR2_ISP_CLKA_600MHZ=y
BR2_ISP_CLKA_SCLKA=y
BR2_ISP_CLK_200MHZ=y
BR2_ISP_CLK_SCLKA=y
BR2_PACKAGE_GPSD_DEVICES="tcp://192.168.1.1:11010"
BR2_PACKAGE_THINGINO_GPSD=y
BR2_PACKAGE_THINGINO_KOPT_DWC2=y
BR2_PACKAGE_THINGINO_KOPT_DWC2_WIFI_ONLY=y
BR2_PACKAGE_THINGINO_KOPT_MMC0=y
BR2_PACKAGE_THINGINO_KOPT_MMC0_PB_4BIT=y
BR2_PACKAGE_THINGINO_KOPT_USB_HUB=y
BR2_PACKAGE_USBNET=y
BR2_PACKAGE_USBNET_CDC_ETHER=y
BR2_PACKAGE_USBNET_QMI_WWAN=y
BR2_PACKAGE_USBNET_RNDIS=y
BR2_SENSOR_1_NAME="sc2331"
BR2_THINGINO_AUDIO=y
BR2_THINGINO_AUDIO_GPIO=39
BR2_THINGINO_AUDIO_GPIO_LOW=y
BR2_THINGINO_BUTTON=y
BR2_THINGINO_LED_B_ACTIVE_LOW=y
BR2_THINGINO_LED_B_GPIO=40
BR2_THINGINO_LED_R_ACTIVE_LOW=y
BR2_THINGINO_LED_R_GPIO=46
BR2_THINGINO_MOTORS=y
BR2_THINGINO_RMEM_MB=22
BR2_THINGINO_SDCARD=y
FLASH_SIZE_MB=8
```

## package/thingino-firewall/Config.in
```kconfig
config BR2_PACKAGE_THINGINO_FIREWALL
	bool "thingino-firewall"
	depends on BR2_PACKAGE_THINGINO_KOPT
	select BR2_PACKAGE_THINGINO_KOPT_NETFILTER
	select BR2_PACKAGE_IPTABLES
	help
	  Inbound IPv4/IPv6 packet filter built on iptables, with a
	  Web UI page under Settings > Firewall.

	  When enabled, new inbound connections are accepted only from
	  the trusted addresses/subnets. Loopback, replies to outbound
	  connections and DHCP replies are always allowed. The filter is
	  not applied while the camera is in captive-portal mode.

	  Settings are read from the "firewall" object in
	  /etc/thingino.json: enabled (bool), allow_ping (bool) and
	  trusted (space-separated list of IPs or CIDR subnets).
```

## package/thingino-gpsd/Config.in
```kconfig
config BR2_PACKAGE_THINGINO_GPSD
	bool "thingino gpsd service"
	depends on BR2_USE_MMU
	depends on BR2_TOOLCHAIN_HAS_THREADS
	depends on !BR2_STATIC_LIBS
	select BR2_PACKAGE_GPSD
	select BR2_PACKAGE_GPSD_DAEMON
	select BR2_PACKAGE_GPSD_CLIENTS
	help
	  Installs gpsd with its client tools (gpspipe, gpsctl, ...) and
	  gps-select, which runs gpsd on the best available source and
	  re-evaluates whenever a USB serial port appears or goes away
	  and on DHCP events:

	  1. the NMEA port of a USB modem (Quectel, Qualcomm, Sierra),
	     with GPS switched on via AT command;
	  2. the fallback source from BR2_PACKAGE_GPSD_DEVICES, e.g.
	     tcp://192.168.1.1:11010 for a MiFi, used only while its TCP
	     port accepts connections (a /dev node only while present);
	  3. otherwise gpsd is not running.

	  Optional keys in the "gps" object of /etc/thingino.json:
	  enabled (false disables gpsd), modem_nmea (NMEA tty),
	  modem_at (AT tty), modem_init (command sent to modem_at).
```

## package/thingino-uqmi/Config.in
```kconfig
config BR2_PACKAGE_THINGINO_UQMI
	bool "thingino-uqmi"
	depends on !BR2_STATIC_LIBS # thingino-libubox
	depends on BR2_TOOLCHAIN_HAS_SYNC_4 # thingino-libubox
	select BR2_PACKAGE_THINGINO_LIBUBOX
	help
	  uqmi from OpenWrt, a command line tool to configure LTE modems
	  in QMI mode, built against thingino-libubox and thingino-jct.

	  Use this instead of Buildroot's uqmi: that one selects
	  Buildroot's libubox, whose libubox.so replaces the
	  thingino-libubox build that uhttpd is linked against.

	  https://git.openwrt.org/project/uqmi.git
```
